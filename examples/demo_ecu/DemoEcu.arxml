AUTOSAR XML (schema 4.0)
package /DemoEcu/SwComponentTypes
  application sw component type BrakeCtrl
    behavior BrakeCtrl_IB
      timing event TE_BrakeCtrl_10ms: start-on-event=BrakeCtrl_Run10ms, period=0.01
      runnable BrakeCtrl_Run10ms
  application sw component type SpeedMonitor
    behavior SpeedMonitor_IB
      timing event TE_SpeedMon_5ms: start-on-event=SpeedMon_Run5ms, period=0.005
      runnable SpeedMon_Run5ms
  application sw component type Diagnostics
    behavior Diagnostics_IB
      timing event TE_Diag_100ms: start-on-event=Diag_Run100ms, period=0.1
      runnable Diag_Run100ms
  application sw component type HmiGateway
    behavior HmiGateway_IB
      timing event TE_Hmi_20ms: start-on-event=Hmi_Run20ms, period=0.02
      runnable Hmi_Run20ms
package /DemoEcu/EcucConfig
  module config EcuC
    EcucHardware
      Core0 (EcucCoreDefinition): EcucCoreId=0
      Core1 (EcucCoreDefinition): EcucCoreId=1
  module config Os
    3 x OsTask:
      Task_AsilC_10ms
      Task_AsilC_5ms
      Task_QM_100ms
    3 x OsApplication:
      OsApp_AsilC_Core0: OsTrusted=true, OsApplicationCoreRef=Core0, OsAppTaskRef=Task_AsilC_10ms
      OsApp_QM_Core0: OsTrusted=false, OsApplicationCoreRef=Core0, OsAppTaskRef=Task_QM_100ms
      OsApp_AsilC_Core1: OsTrusted=false, OsApplicationCoreRef=Core1, OsAppTaskRef=Task_AsilC_5ms
  module config Rte
    RteSwComponentInstances (RteSwComponentInstance)
      4 x RteEventToTaskMapping:
        Map_BrakeCtrl_10ms: RteEventRef=TE_BrakeCtrl_10ms, RteMappedToTaskRef=Task_AsilC_10ms
        Map_SpeedMon_5ms: RteEventRef=TE_SpeedMon_5ms, RteMappedToTaskRef=Task_AsilC_5ms
        Map_Diag_100ms: RteEventRef=TE_Diag_100ms, RteMappedToTaskRef=Task_QM_100ms
        Map_Hmi_20ms: RteEventRef=TE_Hmi_20ms, RteMappedToTaskRef=Task_AsilC_5ms
